## boards/shields/pointr/Kconfig.defconfig
```kconfig
if SHIELD_POINTR_RIGHT
    config ZMK_KEYBOARD_NAME
        default "pointr"

    config ZMK_SPLIT_ROLE_CENTRAL
        default y
endif

if SHIELD_POINTR_LEFT || SHIELD_POINTR_RIGHT
    config ZMK_SPLIT
        default y
endif
```

## boards/shields/pointr/Kconfig.shield
```kconfig
config SHIELD_POINTR_LEFT
    def_bool $(shields_list_contains,pointr_left)

config SHIELD_POINTR_RIGHT
    def_bool $(shields_list_contains,pointr_right)
```
